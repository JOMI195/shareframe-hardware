## Config.in
```kconfig
source "$BR2_EXTERNAL_SHAREFRAME_PATH/package/sysinfo/Config.in"
source "$BR2_EXTERNAL_SHAREFRAME_PATH/package/shareframe-init/Config.in"
source "$BR2_EXTERNAL_SHAREFRAME_PATH/package/shareframe-initramfs/Config.in"
source "$BR2_EXTERNAL_SHAREFRAME_PATH/package/shareframe-rauc/Config.in"
source "$BR2_EXTERNAL_SHAREFRAME_PATH/package/lgpio/Config.in"
source "$BR2_EXTERNAL_SHAREFRAME_PATH/package/shareframe-board/Config.in"
source "$BR2_EXTERNAL_SHAREFRAME_PATH/package/shareframe-dashboard-frontend/Config.in"
source "$BR2_EXTERNAL_SHAREFRAME_PATH/package/s6-linux-init-host/Config.in.host"
```

## br2-external/package/shareframe-init/Config.in
```kconfig
config BR2_PACKAGE_SHAREFRAME_INIT
	bool "shareframe-init (s6 PID1 basedir + s6-rc DB)"
	depends on BR2_INIT_NONE
	select BR2_PACKAGE_S6
	select BR2_PACKAGE_S6_RC
	select BR2_PACKAGE_S6_LINUX_INIT
	select BR2_PACKAGE_EXECLINE
	select BR2_PACKAGE_HOST_S6_RC
	select BR2_PACKAGE_HOST_S6_LINUX_INIT_HOST
	help
	  Setzt s6 als PID1 ein: erzeugt /etc/s6-linux-init/current per
	  s6-linux-init-maker, kompiliert die s6-rc-Service-DB nach
	  /etc/s6-rc/compiled, ueberschreibt rc.init/rc.shutdown mit dem
	  eigenen Stage-2-Script und legt /init + /sbin/init als Symlinks
	  auf das s6-init-Binary ab.
```

## br2-external/package/shareframe-initramfs/Config.in
```kconfig
config BR2_PACKAGE_SHAREFRAME_INITRAMFS
	bool "shareframe-initramfs"
	depends on BR2_PACKAGE_BUSYBOX
	depends on BR2_TOOLCHAIN_USES_MUSL
	help
	  Tiny initramfs that boots from a squashfs rootfs slot
	  and applies a tmpfs overlay so / is writable.

	  Produces $(BINARIES_DIR)/initramfs.cpio.gz.
```

## br2-external/package/shareframe-rauc/Config.in
```kconfig
config BR2_PACKAGE_SHAREFRAME_RAUC
	bool "shareframe-rauc"
	depends on BR2_PACKAGE_RAUC
	help
	  RAUC system.conf + per-slot post-install hook for the
	  shareframe-pi0w A/B layout. Installs the dev CA cert
	  (from package/shareframe-rauc/files/ca.cert.pem) into
	  /etc/rauc/ as the trust anchor for bundle verification.
```

## br2-external/package/tryboot-reboot/Config.in
```kconfig
config BR2_PACKAGE_TRYBOOT_REBOOT
	bool "tryboot-reboot"
	help
	  Tiny static tool issuing reboot(RESTART2, "0 tryboot") so the Pi
	  firmware boots the staged A/B slot exactly once. Invoked by the
	  s6-linux-init rc.shutdown.final hook when /run/tryboot exists.
```

## package/lgpio/Config.in
```kconfig
config BR2_PACKAGE_LGPIO
	bool "lgpio"
	help
	  The lg archive (liblgpio): a library for Linux single-board
	  computers to access GPIO, I2C, SPI and serial lines via the
	  GPIO character device.

	  Required by the Waveshare e-Paper driver (USE_LGPIO_LIB).

	  http://abyz.me.uk/lg/
```

## package/s6-linux-init-host/Config.in.host
```kconfig
config BR2_PACKAGE_HOST_S6_LINUX_INIT_HOST
	bool "host s6-linux-init (s6-linux-init-maker)"
	help
	  Host-Build von s6-linux-init. Liefert s6-linux-init-maker,
	  um beim Buildroot-Build das s6 PID1-basedir zu erzeugen
	  (Buildroot selbst hat kein host-s6-linux-init).

	  https://skarnet.org/software/s6-linux-init/
```

## package/shareframe-board/Config.in
```kconfig
config BR2_PACKAGE_SHAREFRAME_BOARD
	bool "shareframe-board (display, websocket, dashboard, heartbeat)"
	depends on BR2_INSTALL_LIBSTDCPP
	depends on BR2_TOOLCHAIN_GCC_AT_LEAST_14
	select BR2_PACKAGE_OPENSSL
	select BR2_PACKAGE_SQLITECPP
	select BR2_PACKAGE_SPDLOG
	select BR2_PACKAGE_LGPIO
	help
	  shareframe-display, shareframe-websocket, shareframe-dashboard and
	  shareframe-heartbeat binaries built from the sibling repo at ../shareframe-board.
	  Installs to /usr/bin, /etc/shareframe, /usr/share/shareframe.
	  Per-device .env.secrets.toml lives on /data and is NOT
	  installed by this package.
```

## package/shareframe-dashboard-frontend/Config.in
```kconfig
config BR2_PACKAGE_SHAREFRAME_DASHBOARD_FRONTEND
	bool "shareframe-dashboard-frontend (static web UI)"
	select BR2_PACKAGE_NGINX
	help
	  React dashboard built with Vite at firmware-build time and
	  installed to /usr/share/shareframe/dashboard-frontend, served by
	  nginx on port 80. nginx reverse-proxies /api/ to the local
	  dashboard backend on 127.0.0.1:8080.

	  Built from the sibling repo at ../shareframe-board/dashboard-frontend.
```

## package/shareframe-services/Config.in
```kconfig
config BR2_PACKAGE_SHAREFRAME_SERVICES
	bool "shareframe-services"
	select BR2_PACKAGE_HOST_SQUASHFS
	help
	  Bundles per-board C++ services into a single read-only squashfs
	  at /opt/services.sqfs. Mounted at boot via mount-services-sqfs.
	  Per-service writable overlays land on /data/services/<name>/upper.
```

## package/sysinfo/Config.in
```kconfig
config BR2_PACKAGE_SYSINFO
	bool "sysinfo"
	help
	  Fastfetch-style Shareframe-Board system banner: a full-width
	  ASCII logo followed by host, kernel, uptime, CPU/temp/load,
	  memory, disk and network rows. Reads all metrics from the
	  shareframe-sysinfo overlay script; printed at login.
```
